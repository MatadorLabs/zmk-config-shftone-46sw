## 46sw/boards/shields/shftone-46sw/Kconfig.shield
```kconfig
config SHIELD_SHFTONE46SW_LEFT
    def_bool $(shields_list_contains,shftone46sw_left)

config SHIELD_SHFTONE46SW_RIGHT
    def_bool $(shields_list_contains,shftone46sw_right)
    
```

## boards/shields/shftone-46sw/Kconfig.defconfig
```kconfig
if SHIELD_SHFTONE46SW_LEFT

config ZMK_KEYBOARD_NAME
    default "SHFT.one 46sw"

config ZMK_SPLIT_ROLE_CENTRAL
    default y

endif

if SHIELD_SHFTONE46SW_LEFT || SHIELD_SHFTONE46SW_RIGHT

config ZMK_SPLIT
    default y

endif
```
